## main/Kconfig.projbuild
```kconfig
menu "Primitus Omni Configuration"

config WIFI_SSID
    string "WiFi SSID"
    default "myssid"
    help
	SSID (network name) for the demo to connect to.

config WIFI_PASSWORD
    string "WiFi Password"
    default "mypassword"
    help
	WiFi password (WPA or WPA2) for the demo to use.


endmenu
```
